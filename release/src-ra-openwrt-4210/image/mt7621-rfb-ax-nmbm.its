## release/src-ra-openwrt-4210/image/mt7621-rfb-ax-nmbm.its
```
/dts-v1/;

/ {
	description = "MIPS OpenWrt FIT (Flattened Image Tree)";
	#address-cells = <1>;

	images {
		kernel@1 {
			description = "MIPS OpenWrt Linux-4.4.198";
			data = /incbin/("/repo/Fail_GPL/asuswrt/release/src-ra-openwrt-4210/router/mipsel-musl/zImage.img");
			type = "kernel";
			arch = "mips";
			os = "linux";
			compression = "lzma";
			load = <0x81001000>;
			entry = <0x81001000>;
			hash@1 {
				algo = "crc32";
			};
			hash@2 {
				algo = "sha1";
			};
		};


		fdt@1 {
			description = "MIPS OpenWrt mt7621-rfb-ax-nmbm device tree blob";
			data = /incbin/("/repo/Fail_GPL/asuswrt/release/src-ra-openwrt-4210/linux/linux-4.4.198/arch/mips/boot/dts/ralink/mt7621-rfb-ax-nmbm.dtb");
			type = "flat_dt";
			arch = "mips";
			compression = "none";
			hash@1 {
				algo = "crc32";
			};
			hash@2 {
				algo = "sha1";
			};
		};


	};

	configurations {
		default = "config@1";
		config@1 {
			description = "OpenWrt";
			kernel = "kernel@1";
			fdt = "fdt@1";
		};
	};
};
```
